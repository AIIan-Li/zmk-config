## config/boards/shields/Allankeyboard/Kconfig.shield
```kconfig
config SHIELD_ALLANKEYBOARD
    def_bool $(shields_list_contains, Allankeyboard)
```

## config/boards/shields/Kconfig.defconfig
```kconfig
if SHIELD_ALLANKEYBOARD

config ZMK_KEYBOARD_NAME
    default "Allankeyboard"

endif
```
